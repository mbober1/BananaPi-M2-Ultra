## sources/meta-allwinner/conf/layer.conf
```bitbake
# We have a conf and classes directory, add to BBPATH
BBPATH .= ":${LAYERDIR}"

# We have recipes-* directories, add to BBFILES
BBFILES += "${LAYERDIR}/recipes-*/*/*.bb \
            ${LAYERDIR}/recipes-*/*/*.bbappend"

BBFILE_COLLECTIONS += "meta-allwinner"
BBFILE_PATTERN_meta-allwinner = "^${LAYERDIR}/"
BBFILE_PRIORITY_meta-allwinner = "10"

LAYERDEPENDS_meta-allwinner = "core"
LAYERSERIES_COMPAT_meta-allwinner = "scarthgap"
```

## sources/meta-allwinner/conf/machine/bananapi-m2ultra.conf
```bitbake
#@TYPE: Machine
#@NAME: bananapi-m2plus
#@DESCRIPTION: Machine configuration for the Banana Pi M2 Ultra

require conf/machine/include/soc-family.inc
include conf/machine/include/arm/armv7a/tune-cortexa7.inc

DEFAULTTUNE = "cortexa7thf-neon-vfpv4"

SOC_FAMILY = "sun8i"

PREFERRED_PROVIDER_virtual/kernel = "linux-yocto"
PREFERRED_PROVIDER_virtual/bootloader = "u-boot"
IMAGE_FSTYPES = "wic wic.zst tar.zst"
# MACHINE_EXTRA_RRECOMMENDS += "kernel-modules"
EXTERNAL_KERNEL_DEVICETREE = "${DEPLOY_DIR_IMAGE}/devicetree"
# # KERNEL_DTC_FLAGS += "-@"
KERNEL_DEVICETREE = "allwinner/sun8i-r40-bananapi-m2-ultra.dtb"
KERNEL_CLASSES = "kernel-fitimage"
KERNEL_IMAGETYPE = "fitImage"
KBUILD_DEFCONFIG = "sunxi_defconfig"
SERIAL_CONSOLES = "115200;ttyS0"

UBOOT_MACHINE = "Bananapi_M2_Ultra_defconfig"
UBOOT_ENTRYPOINT = "0x40008000"
SPL_BINARY = "u-boot-sunxi-with-spl.bin"
IMAGE_BOOT_FILES = "${SPL_BINARY}"


UBOOT_EXTLINUX = "1"
# # UBOOT_EXTLINUX_ROOT = "root=PARTLABEL=rootfsA"
UBOOT_EXTLINUX_ROOT = "root=/dev/mmcblk0p${bootpart}"
UBOOT_EXTLINUX_FDTDIR = "${@bb.utils.contains('KERNEL_IMAGETYPE', 'fitImage', '', '/boot', d)}"
UBOOT_EXTLINUX_FDT = "${@bb.utils.contains('KERNEL_IMAGETYPE', 'fitImage', '', '/boot/${NONFITDT}', d)}"
UBOOT_EXTLINUX_CONSOLE = "earlycon console=tty1 console=ttyS0,115200n8"
UBOOT_EXTLINUX_KERNEL_ARGS = "rootwait rw rootfstype=ext4"
UBOOT_EXTLINUX_KERNEL_IMAGE = "/boot/${KERNEL_IMAGETYPE}"
UBOOT_EXTLINUX_LABELS = "default"
UBOOT_EXTLINUX_MENU_DESCRIPTION:default = "${MACHINE}"


WKS_FILES = "sunxi-sdcard-image.wks.in"

WKS_FILE_DEPENDS ?= " \
    virtual/kernel \
    virtual/bootloader \
    e2fsprogs-native \
"


MACHINE_ESSENTIAL_EXTRA_RDEPENDS += " \
    kernel-image \
    kernel-devicetree \
    kernel-modules \
    u-boot \
"

MACHINE_FEATURES = "alsa apm keyboard rtc serial screen usbgadget usbhost vfat"
```
